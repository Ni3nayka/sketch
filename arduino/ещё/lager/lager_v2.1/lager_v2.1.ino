#define SR     11
#define DR     13
#define SL     10
#define DL     12

byte P[12][24] {
  {0,0,0,  0,0,0,  0,0,0,  0,0,0,  0,0,0,  0,0,0,  0,0,0,  0,0,0},
  {0,0,0,  0,0,0,  0,0,0,  0,0,0,  0,0,0,  0,0,0,  0,0,0,  0,0,0},
  {0,0,0,  0,0,0,  0,0,0,  0,0,0,  0,0,0,  0,0,0,  0,0,0,  0,0,0},
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  {0,0,0,  0,0,0,  0,0,0,  0,0,0,  0,0,0,  0,0,0,  0,0,0,  0,0,0},
};

byte Q[21][45] {                                              
  {0,0,0,  0,0,0,  0,0,0,  0,0,0,  0,0,0,  0,0,0,  0,0,0,  0,0,0,  0,0,0,  0,0,0,  0,0,0,  0,0,0,  0,0,0,  0,0,0,  0,0,0},
  {0,0,0,  0,0,0,  0,0,0,  0,0,0,  0,0,0,  0,0,0,  0,0,0,  0,0,0,  0,0,0,  0,0,0,  0,0,0,  0,0,0,  0,0,0,  0,0,0,  0,0,0},
  {0,0,0,  0,0,0,  0,0,0,  0,0,0,  0,0,0,  0,0,0,  0,0,0,  0,0,0,  0,0,0,  0,0,0,  0,0,0,  0,0,0,  0,0,0,  0,0,0,  0,0,0},
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  {0,0,0,  0,0,0,  0,0,0,  0,0,0,  0,0,0,  0,0,0,  0,0,0,  0,0,0,  0,0,0,  0,0,0,  0,0,0,  0,0,0,  0,0,0,  0,0,0,  0,0,0},
                                                             //
  {0,0,0,  0,0,0,  0,0,0,  0,0,0,  0,0,0,  0,0,0,  0,0,0,  0,0,0,  0,0,0,  0,0,0,  0,0,0,  0,0,0,  0,0,0,  0,0,0,  0,0,0},
  {0,0,0,  0,0,0,  0,0,0,  0,0,0,  0,0,0,  0,0,0,  0,0,0,  0,0,0,  0,0,0,  0,0,0,  0,0,0,  0,0,0,  0,0,0,  0,0,0,  0,0,0},
  {0,0,0,  0,0,0,  0,0,0,  0,0,0,  0,0,0,  0,0,0,  0,0,0,  0,0,0,  0,0,0,  0,0,0,  0,0,0,  0,0,0,  0,0,0,  0,0,0,  0,0,0},
                                                             //
  {0,0,0,  0,0,0,  0,0,0,  0,0,0,  0,0,0,  0,0,0,  0,0,0,  0,0,0,  0,0,0,  0,0,0,  0,0,0,  0,0,0,  0,0,0,  0,0,0,  0,0,0},
  {0,0,0,  0,0,0,  0,0,0,  0,0,0,  0,0,0,  0,0,0,  0,0,0,  0,0,0,  0,0,0,  0,0,0,  0,0,0,  0,0,0,  0,0,0,  0,0,0,  0,0,0},
  {0,0,0,  0,0,0,  0,0,0,  0,0,0,  0,0,0,  0,0,0,  0,0,0,  0,0,0,  0,0,0,  0,0,0,  0,0,0,  0,0,0,  0,0,0,  0,0,0,  0,0,0},
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  {0,0,0,  0,0,0,  0,0,0,  0,0,0,  0,0,0,  0,0,0,  0,0,0,  0,0,0,  0,0,0,  0,0,0,  0,0,0,  0,0,0,  0,0,0,  0,0,0,  0,0,0},
};

float M = 50;
float p = 0;
float A = 0; // какая локация
int a, b, c, d, e, f, g, h, i, j, x, y, z; 
int n = 1;   // направление
long int k = 0;

void setup() {
  Serial.begin(115200);
  pinMode (13, OUTPUT);
  pinMode (4 , OUTPUT);
  pinMode (DR, OUTPUT);
  pinMode (DL, OUTPUT);
  //zum();
  while (digitalRead(2) == 1) { delay(10); }
  //zum();
  linia();
}

void loop() {
  //test_d();
  //test_e();
  //linia();
}

void linia() {
  //k = millis();
  while (f == 0) {
    while ((((analogRead(A1) > 600) || (analogRead(A3) > 600))) && ((analogRead(A2)) < 800)) {
      //e = ((analogRead(A1)) - (analogRead(A3)) + 70)*(M/500);
      e = ((analogRead(A1)) - (analogRead(A3)) + 70)*(M/500);
      digitalWrite(DL, 1);
      analogWrite (SL, M + e);
      digitalWrite(DR, 1);
      analogWrite (SR, M - e);
      k++;
      delay(1);
    }
    analogWrite (SL, 50);
    analogWrite (SR, 50);
    if ((analogRead(A2)) > 800) {
      f++;
    }
    else {
      while ((analogRead(A1) < 600) && (analogRead(A3) < 600)) {  // проверка на стык локаций
        a++; k++;
        delay(1);
      }
      if (a > 50) { f++; }   // 100 - мс сколько длится стык локаций
      a = 0;
    }
  }
  //a = (millis() - k + 300)/1000 - 1;
  a = (k + 300)/1000 - 1;
  Serial.println(a);
  p = 0;
  f = 0;
  k = 0;
  analogWrite (SL, 0);
  analogWrite (SR, 0);
  //-------------------------------------------------- проехали по линии до какого-то элемента
  
}

void start() {
  
}

void test_d() {
  Serial.print(analogRead(A1));
  Serial.print("   ");
  Serial.print(analogRead(A2));
  Serial.print("   ");
  Serial.println(analogRead(A3));
  delay(100);
}

void test_e() {
  e = ((analogRead(A1)) - (analogRead(A3)) + 70);
  Serial.print(e);
  Serial.print("   ");
  e = e*(M/500);
  Serial.println(e);
  delay(100);
}

void zum() {
  digitalWrite(4, 1);
  delay(100);
  digitalWrite(4, 0);
  delay(100);
  digitalWrite(4, 1);
  delay(100);
  digitalWrite(4, 0);
  delay(100);
}


