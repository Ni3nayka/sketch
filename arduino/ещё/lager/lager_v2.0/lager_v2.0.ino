#define SR     11
#define DR     13
#define SL     10
#define DL     12

byte P[12][24] {
  {0,0,0,  0,0,0,  0,0,0,  0,0,0,  0,0,0,  0,0,0,  0,0,0,  0,0,0},
  {0,0,0,  0,0,0,  0,0,0,  0,0,0,  0,0,0,  0,0,0,  0,0,0,  0,0,0},
  {0,0,0,  0,0,0,  0,0,0,  0,0,0,  0,0,0,  0,0,0,  0,0,0,  0,0,0},
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  {0,0,0,  0,0,0,  0,0,0,  0,0,0,  0,0,0,  0,0,0,  0,0,0,  0,0,0},
};

byte Q[21][45] {                                              
  {0,0,0,  0,0,0,  0,0,0,  0,0,0,  0,0,0,  0,0,0,  0,0,0,  0,0,0,  0,0,0,  0,0,0,  0,0,0,  0,0,0,  0,0,0,  0,0,0,  0,0,0},
  {0,0,0,  0,0,0,  0,0,0,  0,0,0,  0,0,0,  0,0,0,  0,0,0,  0,0,0,  0,0,0,  0,0,0,  0,0,0,  0,0,0,  0,0,0,  0,0,0,  0,0,0},
  {0,0,0,  0,0,0,  0,0,0,  0,0,0,  0,0,0,  0,0,0,  0,0,0,  0,0,0,  0,0,0,  0,0,0,  0,0,0,  0,0,0,  0,0,0,  0,0,0,  0,0,0},
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  {0,0,0,  0,0,0,  0,0,0,  0,0,0,  0,0,0,  0,0,0,  0,0,0,  0,0,0,  0,0,0,  0,0,0,  0,0,0,  0,0,0,  0,0,0,  0,0,0,  0,0,0},
                                                             //
  {0,0,0,  0,0,0,  0,0,0,  0,0,0,  0,0,0,  0,0,0,  0,0,0,  0,0,0,  0,0,0,  0,0,0,  0,0,0,  0,0,0,  0,0,0,  0,0,0,  0,0,0},
  {0,0,0,  0,0,0,  0,0,0,  0,0,0,  0,0,0,  0,0,0,  0,0,0,  0,0,0,  0,0,0,  0,0,0,  0,0,0,  0,0,0,  0,0,0,  0,0,0,  0,0,0},
  {0,0,0,  0,0,0,  0,0,0,  0,0,0,  0,0,0,  0,0,0,  0,0,0,  0,0,0,  0,0,0,  0,0,0,  0,0,0,  0,0,0,  0,0,0,  0,0,0,  0,0,0},
                                                             //
  {0,0,0,  0,0,0,  0,0,0,  0,0,0,  0,0,0,  0,0,0,  0,0,0,  0,0,0,  0,0,0,  0,0,0,  0,0,0,  0,0,0,  0,0,0,  0,0,0,  0,0,0},
  {0,0,0,  0,0,0,  0,0,0,  0,0,0,  0,0,0,  0,0,0,  0,0,0,  0,0,0,  0,0,0,  0,0,0,  0,0,0,  0,0,0,  0,0,0,  0,0,0,  0,0,0},
  {0,0,0,  0,0,0,  0,0,0,  0,0,0,  0,0,0,  0,0,0,  0,0,0,  0,0,0,  0,0,0,  0,0,0,  0,0,0,  0,0,0,  0,0,0,  0,0,0,  0,0,0},
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  {0,0,0,  0,0,0,  0,0,0,  0,0,0,  0,0,0,  0,0,0,  0,0,0,  0,0,0,  0,0,0,  0,0,0,  0,0,0,  0,0,0,  0,0,0,  0,0,0,  0,0,0},
};

float M = 50;
float p = 0;
float A = 0; // какая локация
int a, b, c, d, e, f, g, h, i, j, k, x, y, z; 
int n = 1;   // направление

void setup() {
  Serial.begin(115200);
  pinMode (13, OUTPUT);
  pinMode (4 , OUTPUT);
  pinMode (DR, OUTPUT);
  pinMode (DL, OUTPUT);
  //zum();
  while (digitalRead(2) == 1) { delay(10); }
  //zum();
  //linia();
}

void loop() {
  test_d();
  //test_e();
  //linia();
}

void linia() {
  while (f == 0) {
    while ((((analogRead(A1) > 600) || (analogRead(A3) > 600))) && ((analogRead(A2)) < 900) && (p < 25000)) {
      e = ((analogRead(A1)) - (analogRead(A3)) + 70)*(M/500);
      digitalWrite(DL, 1);
      analogWrite (SL, M + e);
      digitalWrite(DR, 1);
      analogWrite (SR, M - e);
      p = p + e;
      //delay(1);
    }
    while ((analogRead(A1) < 700) && (analogRead(A3) < 700)) {  // проверка на стык локаций
      a++;
      delay(1);
    }
    if ((a > 100) || ((analogRead(A2)) < 900)) { f++; }   // 100 - мс сколько длится стык локаций
    a = 0;
  }
  p = 0;
  f = 0;
  analogWrite (SL, 0);
  analogWrite (SR, 0);
  //-------------------------------------------------- проехали о линии до какого-то элемента
  if ((analogRead(A2)) < 900) {
    // тупик
    a = 4;
  }
  else {
    // угол или перекресток
    if (abs(e) > 5) { // угол (возможно надо будет менять коэффицент ошибки)!!!!!!!!!!!!!!!
      if ((analogRead(A2)) > 950) {  // поворот на 90 градусов в любую сторону
        //digitalWrite(4, 1);
        if (e < 0) {
          while ((analogRead(A2)) > 950) {
            digitalWrite(DL, 0);
            analogWrite (SL, 50);
            digitalWrite(DR, 1);
            analogWrite (SR, 50);
          }
          A = 3.1;
        }
        else {
          while ((analogRead(A2)) > 950) {
            digitalWrite(DL, 1);
            analogWrite (SL, 50);
            digitalWrite(DR, 0);
            analogWrite (SR, 50);
          }
          A = 3.2;
        }
        delay(100);
      }
    }
    else { // перекресток
      //a = 5 || 6;
    }
  }
}

void start() {
  
}

void test_d() {
  Serial.print(analogRead(A1));
  Serial.print("   ");
  Serial.print(analogRead(A2));
  Serial.print("   ");
  Serial.println(analogRead(A3));
  delay(100);
}

void test_e() {
  e = ((analogRead(A1)) - (analogRead(A3)) + 70);
  Serial.print(e);
  Serial.print("   ");
  e = e*(M/500);
  Serial.println(e);
  delay(100);
}

void zum() {
  digitalWrite(4, 1);
  delay(100);
  digitalWrite(4, 0);
  delay(100);
  digitalWrite(4, 1);
  delay(100);
  digitalWrite(4, 0);
  delay(100);
}


